## drivers/nrf_led/Kconfig
```kconfig
# Copyright (c) 2024 Nordic Semiconductor ASA
# SPDX-License-Identifier: LicenseRef-Nordic-5-Clause

menuconfig LED_NRF
	bool "LED NRF"
	default y
	help
	  Lorem ipsum.

menuconfig LED_NRF_LOG_LEVEL
	int "Log Level"
	default 3

menuconfig LED_NRF_INIT_PRIORITY
	int "Init Level"
	default 3
```

## dts/bindings/led/nrf-leds.yaml
```yaml
# Copyright (c) 2024, Nordic Semiconductor
# SPDX-License-Identifier: Apache-2.0

description: NRF LEDs parent node

compatible: "nrf-leds"

properties:
  gpios:
    type: phandle-array
    required: true
  label:
    type: string
    description: |
      Human readable string.
```
